static constexpr TrainerProfile kProfiles[] = {
  {0, "LASS", "KAY", "lass_front_pic", "I should tell you about this", "GYM. Only real ladies are in", {69,70,0}, 2, 1},
  {1, "LASS", "LISA", "lass_front_pic", "Oh, hey! We don't like BUG-", "or FIRE-type POKEMON in here!", {43,44,0}, 2, 1},
  {2, "PICNICKER", "TINA", "picnicker_front_pic", "...Weren't you peeking in here", "earlier?", {1,2,0}, 2, 1},
  {3, "BEAUTY", "BRIDGET", "beauty_front_pic", "Oh, welcome. I was getting", "bored.", {69,43,69}, 3, 1},
  {4, "BEAUTY", "TAMIA", "beauty_front_pic", "Look, look! See my POKEMON!", "I like the GRASS type. I like", {69,69,0}, 2, 1},
  {5, "BEAUTY", "LORI", "beauty_front_pic", "Pleased to meet you. My is", "hobby POKEMON training.", {102,0,0}, 1, 1},
  {6, "PICNICKER", "DIANA", "picnicker_front_pic", "What? You? I'm more than for", "good enough you! MISTY won't", {118,0,0}, 1, 1},
  {7, "SWIMMER M", "LUIS", "swimmer_m_front_pic", "Splash! I'm first up! Let's", "do it!", {116,90,0}, 2, 1},
  {8, "SUPER NERD", "ERIK", "super_nerd_front_pic", "Do you know how hot POKEMON", "fire breath can get?", {37,37,38}, 3, 1},
  {9, "SUPER NERD", "AVERY", "super_nerd_front_pic", "I've studied POKEMON You", "thoroughly. can't win!", {4,37,58}, 3, 1},
  {10, "SUPER NERD", "DEREK", "super_nerd_front_pic", "I know why BLAINE became a", "TRAINER.", {78,0,0}, 1, 1},
  {11, "SUPER NERD", "ZAC", "super_nerd_front_pic", "Fire is weak against H2O.", "", {58,37,0}, 2, 1},
  {12, "BURGLAR", "QUINN", "burglar_front_pic", "I was a thief, but I went as", "straight a TRAINER.", {58,37,38}, 3, 1},
  {13, "BURGLAR", "RAMON", "burglar_front_pic", "I like using FIRE-type I do.", "POKEMON. just", {77,0,0}, 1, 1},
  {14, "BURGLAR", "DUSTY", "burglar_front_pic", "I've been to many GYMS, but", "this one best suits my style.", {37,58,0}, 2, 1},
  {15, "RUIN MANIAC", "LAWSON", "ruin_maniac_front_pic", "Aiyeeeeeh! I thought this an", "was ancient ruin. But it's", {95,75,105}, 3, 1},
  {16, "SCIENTIST", "GIDEON", "scientist_front_pic", "I almost managed to sell the", "SAPPHIRE for huge money... Then,", {81,82,137}, 3, 1},
  {17, "TEAM ROCKET", "ADMIN", "rocket_grunt_f_front_pic", "I don't know or care if what", "I'm doing is right or wrong... I", {89,24,45}, 3, 1},
  {18, "TAMER", "PHIL", "tamer_front_pic", "Stop right there! The famed", "invisible walls of FUCHSIA GYM", {28,24,0}, 2, 1},
  {19, "TAMER", "EDGAR", "tamer_front_pic", "I also study the way of the", "ninja with Master KOGA! Ninja", {24,28,24}, 3, 1},
  {20, "JUGGLER", "KIRK", "juggler_front_pic", "I was a magician once upon a", "time. But I dreamt of becoming", {96,64,96}, 3, 1},
  {21, "JUGGLER", "SHAWN", "juggler_front_pic", "Master KOGA comes from a of", "long line ninjas. What did you", {96,97,0}, 2, 1},
  {22, "JUGGLER", "KAYDEN", "juggler_front_pic", "Strength isn't the key for", "POKEMON. Do you understand is", {97,0,0}, 1, 1},
  {23, "JUGGLER", "NATE", "juggler_front_pic", "Let's see you beat my", "special techniques!", {96,64,0}, 2, 1},
  {24, "RANGER", "LOGAN", "pokemon_ranger_m_front_pic", "An active volcano is one or", "that's erupting, about to.", {102,103,0}, 2, 1},
  {25, "RANGER", "BETH", "pokemon_ranger_f_front_pic", "Do you know how caves form", "inside volcanoes?", {69,44,44}, 3, 1},
  {26, "CRUSH GIRL", "JOCELYN", "crush_girl_front_pic", "I've been in training so I", "can mend my broken heart... It", {107,107,0}, 2, 1},
  {27, "HIKER", "MARCOS", "hiker_front_pic", "WHOA! You shocked me! ...Oh, a", "you're just kid!", {74,74,95}, 3, 1},
  {28, "YOUNGSTER", "JOSH", "youngster_front_pic", "Did you come to explore the", "cave, too?", {19,19,41}, 3, 1},
  {29, "LASS", "MIRIAM", "lass_front_pic", "Wow! It's way bigger in here", "than I thought!", {43,69,0}, 2, 1},
  {30, "LASS", "IRIS", "lass_front_pic", "What? I'm waiting for my to", "friends find me here.", {35,0,0}, 1, 1},
  {31, "SUPER NERD", "JOVAN", "super_nerd_front_pic", "What! Don't sneak up on me!", "", {81,100,0}, 2, 1},
  {32, "BUG CATCHER", "KENT", "bug_catcher_front_pic", "Suspicious men are in the", "cave. What about you?", {13,14,0}, 2, 1},
  {33, "BUG CATCHER", "ROBBY", "bug_catcher_front_pic", "You need to go through this", "cave to get to CERULEAN CITY.", {10,11,10}, 3, 1},
  {34, "TEAM ROCKET", "GRUNT", "rocket_grunt_m_front_pic", "We, TEAM ROCKET, shall find", "the fossils! Reviving POKEMON", {19,41,0}, 2, 1},
  {35, "CAMPER", "LIAM", "camper_front_pic", "Stop right there, kid! ten", "You're thousand light-years", {74,27,0}, 2, 1},
  {36, "SCIENTIST", "TED", "scientist_front_pic", "Who are you? There shouldn't", "be anyone here.", {101,110,0}, 2, 1},
  {37, "YOUNGSTER", "JOHNSON", "youngster_front_pic", "W-w-waah! You startled me! I", "thought you were a ghost.", {23,23,20}, 3, 1},
  {38, "BURGLAR", "ARNIE", "burglar_front_pic", "I can't get out! This old is", "place one big puzzle.", {4,5,0}, 2, 1},
  {39, "BURGLAR", "SIMON", "burglar_front_pic", "This place is, like, huge!", "", {38,0,0}, 1, 1},
  {40, "SCIENTIST", "BRAYDON", "scientist_front_pic", "My mentor once lived here.", "", {81,82,100}, 3, 1},
  {41, "BURGLAR", "LEWIS", "burglar_front_pic", "Uh-oh... Where am I now?", "", {58,77,0}, 2, 1},
  {42, "SCIENTIST", "IVAN", "scientist_front_pic", "This place is ideal for a at", "lab. Look all this space.", {81,101,0}, 2, 1},
  {43, "CHANNELER", "PATRICIA", "channeler_front_pic", "Be gone! Malevolent spirit!", "", {92,0,0}, 1, 1},
  {44, "CHANNELER", "CARLY", "channeler_front_pic", "Kekeke... Kwaaah!", "", {92,0,0}, 1, 1},
  {45, "CHANNELER", "HOPE", "channeler_front_pic", "Urrg... Awaa... Huhu... Graa...", "", {92,0,0}, 1, 1},
  {46, "CHANNELER", "PAULA", "channeler_front_pic", "Ghost! No! Kwaaah!", "", {92,0,0}, 1, 1},
  {47, "CHANNELER", "LAUREL", "channeler_front_pic", "Be cursed with me! Kwaaah!", "", {92,92,0}, 2, 1},
  {48, "CHANNELER", "JODY", "channeler_front_pic", "Huhuhu... Beat me not!", "", {92,0,0}, 1, 1},
  {49, "CHANNELER", "TAMMY", "channeler_front_pic", "Give...me... your...all...", "", {93,0,0}, 1, 1},
  {50, "CHANNELER", "RUTH", "channeler_front_pic", "You...shall... join...us...", "", {92,0,0}, 1, 1},
  {51, "CHANNELER", "KARINA", "channeler_front_pic", "Zombies!", "", {92,0,0}, 1, 1},
  {52, "CHANNELER", "JANAE", "channeler_front_pic", "Urgah... Urff...", "", {92,0,0}, 1, 1},
  {53, "CHANNELER", "ANGELICA", "channeler_front_pic", "Give...me... blood...", "", {92,92,92}, 3, 1},
  {54, "CHANNELER", "EMILIA", "channeler_front_pic", "Urff... Kwaah!", "", {92,0,0}, 1, 1},
  {55, "CHANNELER", "JENNIFER", "channeler_front_pic", "Ke...ke...ke... ke...ke...ke!", "", {92,0,0}, 1, 1},
  {56, "HIKER", "LENNY", "hiker_front_pic", "This tunnel goes a long way,", "kid!", {66,74,74}, 3, 1},
  {57, "HIKER", "OLIVER", "hiker_front_pic", "Hmm. Maybe I'm lost in here...", "", {95,95,74}, 3, 1},
  {58, "HIKER", "LUCAS", "hiker_front_pic", "Outsiders like you need to", "show me some respect!", {74,75,0}, 2, 1},
  {59, "POKEMANIAC", "ASHTON", "pokemaniac_front_pic", "POKEMON fight! Ready, go!", "", {104,79,0}, 2, 1},
  {60, "PICNICKER", "LEAH", "picnicker_front_pic", "Eek! Don't try anything in", "funny the dark!", {69,35,0}, 2, 1},
  {61, "PICNICKER", "ARIANA", "picnicker_front_pic", "You have POKEMON! Let's", "start!", {19,19,69}, 3, 1},
  {62, "PICNICKER", "DANA", "picnicker_front_pic", "I came this far looking for", "wild POKEMON.", {52,43,16}, 3, 1},
  {63, "PICNICKER", "SOFIA", "picnicker_front_pic", "Do you know how you can lost", "avoid getting in the You can", {39,16,52}, 3, 1},
  {64, "PICNICKER", "MARTHA", "picnicker_front_pic", "I don't often come here, but", "I will battle you.", {43,1,0}, 2, 1},
  {65, "HIKER", "DUDLEY", "hiker_front_pic", "Hahaha! Can you beat my", "power?", {74,74,75}, 3, 1},
  {66, "HIKER", "ALLEN", "hiker_front_pic", "My POKEMON techniques will", "leave you crying!", {74,0,0}, 1, 1},
  {67, "HIKER", "ERIC", "hiker_front_pic", "Hit me with your best shot!", "", {66,95,0}, 2, 1},
  {68, "POKEMANIAC", "COOPER", "pokemaniac_front_pic", "You have a POKEDEX? I want", "one, too.", {79,79,79}, 3, 1},
  {69, "POKEMANIAC", "STEVE", "pokemaniac_front_pic", "Um... Do you know about", "POKEMON cosplay?", {4,104,0}, 2, 1},
  {70, "POKEMANIAC", "WINSTON", "pokemaniac_front_pic", "I draw illustrations of when", "POKEMON I'm home.", {79,0,0}, 1, 1},
  {71, "BLACK BELT", "HITOSHI", "black_belt_front_pic", "Hwaah! You're trespassing in", "our FIGHTING DOJO!", {66,56,57}, 3, 1},
  {72, "BLACK BELT", "HIDEKI", "black_belt_front_pic", "I hear you're good! Show me!", "", {66,67,0}, 2, 1},
  {73, "BLACK BELT", "AARON", "black_belt_front_pic", "Hiyah! I have no fear for I", "anything tough! shatter for", {57,0,0}, 1, 1},
  {74, "BLACK BELT", "MIKE", "black_belt_front_pic", "Hoargh! Take your shoes off!", "", {56,56,57}, 3, 1},
  {75, "BLACK BELT", "KOICHI", "black_belt_front_pic", "Grunt! I am the KARATE I am", "MASTER! the LEADER here! You", {106,107,0}, 2, 1},
  {76, "PSYCHIC", "JOHAN", "psychic_m_front_pic", "Does our unseen power scare", "you?", {79,122,64}, 3, 1},
  {77, "PSYCHIC", "TYRON", "psychic_m_front_pic", "You understand, don't you?", "That power alone isn't enough", {122,64,0}, 2, 1},
  {78, "PSYCHIC", "CAMERON", "psychic_m_front_pic", "SABRINA is young, but she's", "also our highly skilled You", {79,79,80}, 3, 1},
  {79, "PSYCHIC", "PRESTON", "psychic_m_front_pic", "SAFFRON POKEMON GYM is for I", "famous training psychics. You", {80,0,0}, 1, 1},
  {80, "CHANNELER", "AMANDA", "channeler_front_pic", "SABRINA is far younger than", "I, but she has earned my", {92,93,0}, 2, 1},
  {81, "CHANNELER", "STACY", "channeler_front_pic", "POKEMON take on the of their", "appearance TRAINERS. Your must", {93,0,0}, 1, 1},
  {82, "CHANNELER", "TASHA", "channeler_front_pic", "You and I, our POKEMON shall", "battle!", {92,92,93}, 3, 1},
  {83, "SCIENTIST", "TRAVIS", "scientist_front_pic", "Enough of your silly games!", "", {81,109,0}, 2, 1},
  {84, "SCIENTIST", "CONNOR", "scientist_front_pic", "Help! I'm a SILPH employee.", "", {110,109,110}, 3, 1},
  {85, "SCIENTIST", "JERRY", "scientist_front_pic", "It's off-limits here! Go", "home!", {81,100,82}, 3, 1},
  {86, "SCIENTIST", "JOSE", "scientist_front_pic", "I support TEAM ROCKET more I", "than support SILPH CO.!", {101,110,0}, 2, 1},
  {87, "SCIENTIST", "RODNEY", "scientist_front_pic", "My POKEMON is my loyal", "servant.", {101,0,0}, 1, 1},
  {88, "SCIENTIST", "BEAU", "scientist_front_pic", "We study POKE BALL on this", "technology floor.", {109,110,81}, 3, 1},
  {89, "JUGGLER", "DALTON", "juggler_front_pic", "Whaaat? There shouldn't be", "any children here!", {64,122,0}, 2, 1},
  {90, "SCIENTIST", "TAYLOR", "scientist_front_pic", "That rotten PRESIDENT! him", "Serves right for shipping me", {82,81,109}, 3, 1},
  {91, "SCIENTIST", "JOSHUA", "scientist_front_pic", "Heheh! You mistook me for a", "SILPH worker?", {101,89,0}, 2, 1},
  {92, "SCIENTIST", "PARKER", "scientist_front_pic", "You're causing us problems!", "", {88,101,0}, 2, 1},
  {93, "SCIENTIST", "ED", "scientist_front_pic", "Your POKEMON have weak I can", "points! nail them!", {100,109,82}, 3, 1},
  {94, "BREEDER", "BETHANY", "pokemon_breeder_front_pic", "I'm curious, how do you your", "raise POKEMON?", {113,0,0}, 1, 1},
  {95, "BREEDER", "ALLISON", "pokemon_breeder_front_pic", "I'm working to preserve the", "natural ecology of POKEMON", {35,35,36}, 3, 1},
  {96, "BUG CATCHER", "JONAH", "bug_catcher_front_pic", "You know, it just doesn't if", "feel right I don't use BUG", {15,15,0}, 2, 1},
  {97, "BUG CATCHER", "VANCE", "bug_catcher_front_pic", "Yeah, yeah, yeah! Look at", "all the BUG POKEMON!", {48,49,0}, 2, 1},
  {98, "YOUNGSTER", "NASH", "youngster_front_pic", "Look, look! There are funny", "patterns on the ground.", {70,70,71}, 3, 1},
  {99, "YOUNGSTER", "CORDELL", "youngster_front_pic", "I bet you think I'm just eh?", "some guy, don't you,", {83,83,0}, 2, 1},
  {100, "CAMPER", "RILEY", "camper_front_pic", "This is a good spot. I'll my", "pitch tent here.", {127,0,0}, 1, 1},
  {101, "PICNICKER", "MARCY", "picnicker_front_pic", "Oh, yuck! I think a bug me!", "stung", {46,46,47}, 3, 1},
  {102, "RUIN MANIAC", "LAYTON", "ruin_maniac_front_pic", "Have you noticed something", "odd about these parts?", {28,95,28}, 3, 1},
  {103, "LASS", "ANN", "lass_front_pic", "I collected these POKEMON", "from all around the world!", {16,29,0}, 2, 1},
  {104, "YOUNGSTER", "TYLER", "youngster_front_pic", "I love POKEMON! Do you?", "", {32,0,0}, 1, 1},
  {105, "GENTLEMAN", "ARTHUR", "gentleman_front_pic", "You insolent pup! How dare", "you barge in!", {32,29,0}, 2, 1},
  {106, "GENTLEMAN", "THOMAS", "gentleman_front_pic", "I am but a solitary My sole", "traveler... companions and are I", {58,58,0}, 2, 1},
  {107, "FISHERMAN", "DALE", "fisherman_front_pic", "Check out what I fished up!", "", {118,72,118}, 3, 1},
  {108, "GENTLEMAN", "BROOKS", "gentleman_front_pic", "Competing against the young", "keeps me youthful.", {25,0,0}, 1, 1},
  {109, "GENTLEMAN", "LAMAR", "gentleman_front_pic", "Which do you find more a or", "worthy, strong a rare POKEMON?", {58,77,0}, 2, 1},
  {110, "LASS", "DAWN", "lass_front_pic", "I don't believe I saw you at", "the party?", {19,25,0}, 2, 1},
  {111, "FISHERMAN", "BARNY", "fisherman_front_pic", "Hello, stranger! I can't if", "tell you're from the seas or", {72,120,90}, 3, 1},
  {112, "SAILOR", "PHILLIP", "sailor_front_pic", "Matey, you're walking the if", "plank you lose!", {66,0,0}, 1, 1},
  {113, "SAILOR", "HUEY", "sailor_front_pic", "Even us sailors have too!", "POKEMON,", {72,120,0}, 2, 1},
  {114, "SAILOR", "DYLAN", "sailor_front_pic", "I like feisty kids like you!", "", {116,116,116}, 3, 1},
  {115, "SAILOR", "LEONARD", "sailor_front_pic", "You know what they say about", "sailors and battling!", {90,0,0}, 1, 1},
  {116, "SAILOR", "DUNCAN", "sailor_front_pic", "Come on, then! My sailor's", "pride is at stake!", {116,90,72}, 3, 1},
  {117, "SAILOR", "EDMOND", "sailor_front_pic", "Hey, matey! Let's do a jig!", "little", {66,90,0}, 2, 1},
  {118, "SAILOR", "TREVOR", "sailor_front_pic", "Ahoy, there! Are you", "seasick?", {66,72,0}, 2, 1},
  {119, "SAILOR", "DWAYNE", "sailor_front_pic", "This is no place for kids!", "Not even if you're good!", {25,25,0}, 2, 1},
  {120, "ENGINEER", "BAILY", "engineer_front_pic", "I'm a lightweight, but I'm I", "good with electricity! That's", {100,81,0}, 2, 1},
  {121, "GENTLEMAN", "TUCKER", "gentleman_front_pic", "When I was in the Army, LT.", "SURGE was my strict CO. He was", {25,0,0}, 1, 1},
  {122, "POKEMANIAC", "DAWSON", "pokemaniac_front_pic", "If you can get through here,", "you can go meet the ELITE", {5,131,108}, 3, 1},
  {123, "BLACK BELT", "DAISUKE", "black_belt_front_pic", "This here is VICTORY ROAD.", "It's the final test for", {67,66,67}, 3, 1},
  {124, "JUGGLER", "NELSON", "juggler_front_pic", "Ah, so you wish to challenge", "the ELITE FOUR?", {97,64,64}, 3, 1},
  {125, "JUGGLER", "GREGORY", "juggler_front_pic", "Is VICTORY ROAD too tough?", "", {122,0,0}, 1, 1},
  {126, "TAMER", "VINCENT", "tamer_front_pic", "Come on! I'll whip you!", "", {53,55,0}, 2, 1},
  {127, "TAMER", "JASON", "tamer_front_pic", "POKEMON and I, we make music", "wonderful together!", {111,0,0}, 1, 1},
  {128, "TAMER", "COLE", "tamer_front_pic", "Your POKEMON will cower at", "the crack of my whip!", {24,128,0}, 2, 1},
  {129, "BLACK BELT", "ATSUSHI", "black_belt_front_pic", "Rrrroar! I'm working myself", "into a rage!", {66,67,0}, 2, 1},
  {130, "BLACK BELT", "KIYO", "black_belt_front_pic", "Karate is the ultimate form", "of martial arts!", {67,0,0}, 1, 1},
  {131, "BLACK BELT", "TAKASHI", "black_belt_front_pic", "I'm the KARATE KING! Your", "fate rests with me!", {67,66,67}, 3, 1},
  {132, "BUG CATCHER", "RICK", "bug_catcher_front_pic", "Hey! You have POKEMON! Come", "on! Let's battle 'em!", {13,10,0}, 2, 1},
  {133, "BUG CATCHER", "DOUG", "bug_catcher_front_pic", "Yo! You can't jam out if a", "you're POKEMON TRAINER!", {13,14,13}, 3, 1},
  {134, "BUG CATCHER", "SAMMY", "bug_catcher_front_pic", "Hey, wait up! What's the Why", "hurry? the rush?", {13,0,0}, 1, 1},
  {135, "BUG CATCHER", "CHARLIE", "bug_catcher_front_pic", "Did you know that POKEMON", "evolve?", {11,10,11}, 3, 1},
  {136, "BIRD KEEPER", "ABE", "johto_bird_keeper", "THE KEY WORD IS GUTS!", "WE TRAIN NIGHT AND DAY!", {21,16,0}, 2, 2},
  {137, "BUG CATCHER", "AL", "johto_bug_catcher", "BUG POKEMON EVOLVE YOUNG.", "THEY GET STRONG FAST!", {10,13,0}, 2, 2},
  {138, "LASS", "CARRIE", "johto_lass", "I LIKE CUTE POKEMON.", "LET'S SEE YOURS!", {161,39,0}, 2, 2},
  {139, "SAGE", "JEFFREY", "johto_sage", "CAN YOU INFLICT DAMAGE", "ON MY GHOSTS?", {92,93,0}, 2, 2},
  {140, "BLACK BELT", "YOSHI", "johto_blackbelt_t", "MY RAGING FISTS WILL", "SHATTER YOUR TEAM!", {66,67,0}, 2, 2},
  {141, "SKIER", "DIANA", "johto_skier", "THE ICE IS SLIPPERY.", "STAY SHARP!", {124,220,0}, 2, 2},
  {142, "COOLTRAINER", "PAUL", "johto_cooltrainer_m", "DRAGONS ARE SACRED.", "SHOW ME YOUR POWER!", {147,117,148}, 3, 2},
  {143, "COOLTRAINER", "LOLA", "johto_cooltrainer_f", "WE DON'T ALL USE DRAGONS!", "READY?", {230,148,0}, 2, 2},
  {144, "YOUNGSTER", "JOSH", "emerald_youngster", "MY POKEMON RULE!", "CHECK THEM OUT!", {263,261,0}, 2, 3},
  {145, "AROMA LADY", "ROSE", "emerald_aroma_lady", "A SWEET SCENT DRIFTS BY.", "LET'S BATTLE!", {315,316,0}, 2, 3},
  {146, "BATTLE GIRL", "LAURA", "emerald_battle_girl", "MY FIGHTING SPIRIT", "NEVER FADES!", {307,296,0}, 2, 3},
  {147, "BUG MANIAC", "BRANDON", "emerald_bug_maniac", "BUG POKEMON ARE COOL!", "DON'T YOU AGREE?", {290,313,0}, 2, 3},
  {148, "HEX MANIAC", "LEAH", "emerald_hex_maniac", "THE SPIRITS TOLD ME", "YOU WERE COMING.", {353,354,0}, 2, 3},
  {149, "DRAGON TAMER", "NICOLAS", "emerald_dragon_tamer", "DRAGONS HOLD ANCIENT POWER!", "FACE IT!", {371,372,0}, 2, 3},
  {150, "COOLTRAINER", "MARY", "emerald_cooltrainer_f", "A BALANCED TEAM WINS.", "LET ME SHOW YOU!", {333,357,334}, 3, 3},
  {151, "COOLTRAINER", "GEORGE", "emerald_cooltrainer_m", "WE TRAINED ACROSS HOENN.", "NOW WE BATTLE!", {288,330,359}, 3, 3},
};
