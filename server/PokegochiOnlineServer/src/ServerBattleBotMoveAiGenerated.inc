// Generated by scripts/generate_server_battle_bot.py from the canonical move table.
// Only moves authored into the fixed server roster are retained.
  {8U, PokemonType::Ice, 75U, 100U, MoveCategory::Physical, 15U, 0, 10U, "FREEZE_HIT"},
  {14U, PokemonType::Normal, 0U, 0U, MoveCategory::Status, 30U, 0, 0U, "ATTACK_UP_2"},
  {53U, PokemonType::Fire, 95U, 100U, MoveCategory::Special, 15U, 0, 10U, "BURN_HIT"},
  {56U, PokemonType::Water, 120U, 80U, MoveCategory::Special, 5U, 0, 0U, "HIT"},
  {57U, PokemonType::Water, 95U, 100U, MoveCategory::Special, 15U, 0, 0U, "HIT"},
  {58U, PokemonType::Ice, 95U, 100U, MoveCategory::Special, 10U, 0, 10U, "FREEZE_HIT"},
  {68U, PokemonType::Fighting, 1U, 100U, MoveCategory::Physical, 20U, -5, 0U, "COUNTER"},
  {73U, PokemonType::Grass, 0U, 90U, MoveCategory::Status, 10U, 0, 0U, "LEECH_SEED"},
  {79U, PokemonType::Grass, 0U, 75U, MoveCategory::Status, 15U, 0, 0U, "SLEEP"},
  {85U, PokemonType::Electric, 95U, 100U, MoveCategory::Special, 15U, 0, 10U, "PARALYZE_HIT"},
  {89U, PokemonType::Ground, 100U, 100U, MoveCategory::Physical, 10U, 0, 0U, "EARTHQUAKE"},
  {92U, PokemonType::Poison, 0U, 85U, MoveCategory::Status, 10U, 0, 100U, "TOXIC"},
  {94U, PokemonType::Psychic, 90U, 100U, MoveCategory::Special, 10U, 0, 10U, "SPECIAL_DEFENSE_DOWN_HIT"},
  {105U, PokemonType::Normal, 0U, 0U, MoveCategory::Status, 20U, 0, 0U, "RESTORE_HP"},
  {126U, PokemonType::Fire, 120U, 85U, MoveCategory::Special, 5U, 0, 10U, "BURN_HIT"},
  {127U, PokemonType::Water, 80U, 100U, MoveCategory::Physical, 15U, 0, 0U, "HIT"},
  {137U, PokemonType::Normal, 0U, 75U, MoveCategory::Status, 30U, 0, 0U, "PARALYZE"},
  {141U, PokemonType::Bug, 20U, 100U, MoveCategory::Physical, 15U, 0, 0U, "ABSORB"},
  {147U, PokemonType::Grass, 0U, 100U, MoveCategory::Status, 15U, 0, 0U, "SLEEP"},
  {157U, PokemonType::Rock, 75U, 90U, MoveCategory::Physical, 10U, 0, 30U, "FLINCH_HIT"},
  {183U, PokemonType::Fighting, 40U, 100U, MoveCategory::Physical, 30U, 1, 0U, "QUICK_ATTACK"},
  {188U, PokemonType::Poison, 90U, 100U, MoveCategory::Special, 10U, 0, 30U, "POISON_HIT"},
  {194U, PokemonType::Ghost, 0U, 0U, MoveCategory::Status, 5U, 0, 0U, "DESTINY_BOND"},
  {195U, PokemonType::Normal, 0U, 0U, MoveCategory::Status, 5U, 0, 0U, "PERISH_SONG"},
  {202U, PokemonType::Grass, 60U, 100U, MoveCategory::Special, 5U, 0, 0U, "ABSORB"},
  {216U, PokemonType::Normal, 1U, 100U, MoveCategory::Physical, 20U, 0, 0U, "RETURN"},
  {223U, PokemonType::Fighting, 100U, 50U, MoveCategory::Physical, 5U, 0, 100U, "CONFUSE_HIT"},
  {227U, PokemonType::Normal, 0U, 100U, MoveCategory::Status, 5U, 0, 0U, "ENCORE"},
  {235U, PokemonType::Grass, 0U, 0U, MoveCategory::Status, 5U, 0, 0U, "SYNTHESIS"},
  {238U, PokemonType::Fighting, 100U, 80U, MoveCategory::Physical, 5U, 0, 0U, "HIGH_CRITICAL"},
  {242U, PokemonType::Dark, 80U, 100U, MoveCategory::Physical, 15U, 0, 20U, "SPECIAL_DEFENSE_DOWN_HIT"},
  {243U, PokemonType::Psychic, 1U, 100U, MoveCategory::Special, 20U, -5, 0U, "MIRROR_COAT"},
  {245U, PokemonType::Normal, 80U, 100U, MoveCategory::Physical, 5U, 1, 0U, "QUICK_ATTACK"},
  {247U, PokemonType::Ghost, 80U, 100U, MoveCategory::Special, 15U, 0, 20U, "SPECIAL_DEFENSE_DOWN_HIT"},
  {273U, PokemonType::Normal, 0U, 100U, MoveCategory::Status, 10U, 0, 0U, "WISH"},
  {276U, PokemonType::Fighting, 120U, 100U, MoveCategory::Physical, 5U, 0, 0U, "SUPERPOWER"},
  {282U, PokemonType::Dark, 20U, 100U, MoveCategory::Physical, 20U, 0, 100U, "KNOCK_OFF"},
  {284U, PokemonType::Fire, 150U, 100U, MoveCategory::Special, 5U, 0, 0U, "ERUPTION"},
  {303U, PokemonType::Normal, 0U, 100U, MoveCategory::Status, 10U, 0, 0U, "RESTORE_HP"},
  {309U, PokemonType::Steel, 100U, 85U, MoveCategory::Physical, 10U, 0, 20U, "ATTACK_UP_HIT"},
  {317U, PokemonType::Rock, 50U, 80U, MoveCategory::Physical, 10U, 0, 100U, "SPEED_DOWN_HIT"},
  {326U, PokemonType::Psychic, 80U, 100U, MoveCategory::Special, 30U, 0, 10U, "FLINCH_MINIMIZE_HIT"},
  {337U, PokemonType::Dragon, 80U, 100U, MoveCategory::Physical, 15U, 0, 0U, "HIT"},
  {339U, PokemonType::Fighting, 0U, 0U, MoveCategory::Status, 20U, 0, 0U, "BULK_UP"},
  {347U, PokemonType::Psychic, 0U, 0U, MoveCategory::Status, 20U, 0, 0U, "CALM_MIND"},
  {349U, PokemonType::Dragon, 0U, 0U, MoveCategory::Status, 20U, 0, 0U, "DRAGON_DANCE"},
  {355U, PokemonType::Flying, 0U, 0U, MoveCategory::Status, 10U, 0, 0U, "ROOST"},
  {360U, PokemonType::Steel, 1U, 100U, MoveCategory::Physical, 5U, 0, 0U, "GYRO_BALL"},
  {369U, PokemonType::Bug, 70U, 100U, MoveCategory::Physical, 20U, 0, 0U, "SWITCH_HIT"},
  {370U, PokemonType::Fighting, 120U, 100U, MoveCategory::Physical, 5U, 0, 0U, "CLOSE_COMBAT"},
  {389U, PokemonType::Dark, 80U, 100U, MoveCategory::Physical, 5U, 1, 0U, "HIT_FIRST_IF_TARGET_ATTACKING"},
  {394U, PokemonType::Fire, 120U, 100U, MoveCategory::Physical, 15U, 0, 10U, "RECOIL_BURN_HIT"},
  {396U, PokemonType::Fighting, 90U, 0U, MoveCategory::Special, 20U, 0, 0U, "ALWAYS_HIT"},
  {398U, PokemonType::Poison, 80U, 100U, MoveCategory::Physical, 20U, 0, 30U, "POISON_HIT"},
  {399U, PokemonType::Dark, 80U, 100U, MoveCategory::Special, 15U, 0, 20U, "FLINCH_HIT"},
  {400U, PokemonType::Dark, 70U, 100U, MoveCategory::Physical, 15U, 0, 0U, "HIGH_CRITICAL"},
  {402U, PokemonType::Grass, 80U, 100U, MoveCategory::Physical, 15U, 0, 0U, "HIT"},
  {403U, PokemonType::Flying, 75U, 95U, MoveCategory::Special, 20U, 0, 30U, "FLINCH_HIT"},
  {405U, PokemonType::Bug, 90U, 100U, MoveCategory::Special, 10U, 0, 10U, "SPECIAL_DEFENSE_DOWN_HIT"},
  {406U, PokemonType::Dragon, 90U, 100U, MoveCategory::Special, 10U, 0, 0U, "HIT"},
  {409U, PokemonType::Fighting, 60U, 100U, MoveCategory::Physical, 5U, 0, 0U, "ABSORB"},
  {411U, PokemonType::Fighting, 120U, 70U, MoveCategory::Special, 5U, 0, 10U, "SPECIAL_DEFENSE_DOWN_HIT"},
  {412U, PokemonType::Grass, 80U, 100U, MoveCategory::Special, 10U, 0, 10U, "SPECIAL_DEFENSE_DOWN_HIT"},
  {413U, PokemonType::Flying, 120U, 100U, MoveCategory::Physical, 15U, 0, 0U, "DOUBLE_EDGE"},
  {417U, PokemonType::Dark, 0U, 0U, MoveCategory::Status, 20U, 0, 0U, "SPECIAL_ATTACK_UP_2"},
  {418U, PokemonType::Steel, 40U, 100U, MoveCategory::Physical, 30U, 1, 0U, "QUICK_ATTACK"},
  {421U, PokemonType::Ghost, 70U, 100U, MoveCategory::Physical, 15U, 0, 0U, "HIGH_CRITICAL"},
  {423U, PokemonType::Ice, 65U, 95U, MoveCategory::Physical, 15U, 0, 10U, "FLINCH_FREEZE_HIT"},
  {425U, PokemonType::Ghost, 40U, 100U, MoveCategory::Physical, 30U, 1, 0U, "QUICK_ATTACK"},
  {428U, PokemonType::Psychic, 80U, 90U, MoveCategory::Physical, 15U, 0, 20U, "FLINCH_HIT"},
  {430U, PokemonType::Steel, 80U, 100U, MoveCategory::Special, 10U, 0, 10U, "SPECIAL_DEFENSE_DOWN_HIT"},
  {434U, PokemonType::Dragon, 140U, 90U, MoveCategory::Special, 5U, 0, 100U, "OVERHEAT"},
  {437U, PokemonType::Grass, 140U, 90U, MoveCategory::Special, 5U, 0, 100U, "OVERHEAT"},
  {438U, PokemonType::Grass, 120U, 85U, MoveCategory::Physical, 10U, 0, 0U, "HIT"},
  {440U, PokemonType::Poison, 70U, 100U, MoveCategory::Physical, 20U, 0, 10U, "HIGH_CRITICAL_POISON_HIT"},
  {442U, PokemonType::Steel, 80U, 100U, MoveCategory::Physical, 15U, 0, 30U, "FLINCH_HIT"},
  {444U, PokemonType::Rock, 100U, 80U, MoveCategory::Physical, 5U, 0, 0U, "HIGH_CRITICAL"},
  {446U, PokemonType::Rock, 0U, 0U, MoveCategory::Status, 20U, 0, 0U, "STEALTH_ROCK"},
  {452U, PokemonType::Grass, 120U, 100U, MoveCategory::Physical, 15U, 0, 0U, "DOUBLE_EDGE"},
  {457U, PokemonType::Rock, 150U, 80U, MoveCategory::Physical, 5U, 0, 0U, "RECOIL_HALF"},
  {482U, PokemonType::Poison, 95U, 100U, MoveCategory::Special, 10U, 0, 10U, "POISON_HIT"},
  {483U, PokemonType::Bug, 0U, 101U, MoveCategory::Status, 20U, 0, 0U, "QUIVER_DANCE"},
  {484U, PokemonType::Steel, 1U, 100U, MoveCategory::Physical, 10U, 0, 0U, "HEAT_CRASH"},
  {503U, PokemonType::Water, 80U, 100U, MoveCategory::Special, 15U, 0, 30U, "BURN_HIT"},
  {521U, PokemonType::Electric, 70U, 100U, MoveCategory::Special, 20U, 0, 0U, "SWITCH_HIT"},
  {528U, PokemonType::Electric, 90U, 100U, MoveCategory::Physical, 15U, 0, 0U, "RECOIL"},
  {533U, PokemonType::Fighting, 90U, 100U, MoveCategory::Physical, 20U, 0, 0U, "SACRED_SWORD"},
  {542U, PokemonType::Flying, 120U, 70U, MoveCategory::Special, 10U, 0, 30U, "CONFUSE_HIT"},
  {550U, PokemonType::Electric, 130U, 85U, MoveCategory::Physical, 5U, 0, 20U, "PARALYZE_HIT"},
  {552U, PokemonType::Fire, 80U, 100U, MoveCategory::Special, 10U, 0, 50U, "SPECIAL_ATTACK_UP_HIT"},
  {583U, PokemonType::Fairy, 90U, 90U, MoveCategory::Physical, 10U, 0, 10U, "ATTACK_DOWN_HIT"},
  {585U, PokemonType::Fairy, 95U, 100U, MoveCategory::Special, 15U, 0, 30U, "SPECIAL_ATTACK_DOWN_HIT"},
  {588U, PokemonType::Steel, 0U, 101U, MoveCategory::Status, 10U, 4, 0U, "KINGS_SHIELD"},
  {594U, PokemonType::Water, 15U, 100U, MoveCategory::Physical, 20U, 1, 0U, "MULTI_HIT"},
  {596U, PokemonType::Grass, 0U, 101U, MoveCategory::Status, 10U, 4, 0U, "SPIKY_SHIELD"},
  {601U, PokemonType::Fairy, 0U, 101U, MoveCategory::Status, 10U, 0, 0U, "GEOMANCY"},
  {605U, PokemonType::Fairy, 80U, 100U, MoveCategory::Special, 10U, 0, 0U, "HIT"},
  {614U, PokemonType::Ground, 90U, 100U, MoveCategory::Physical, 10U, 0, 100U, "THOUSAND_ARROWS"},
  {620U, PokemonType::Flying, 120U, 100U, MoveCategory::Physical, 5U, 0, 0U, "CLOSE_COMBAT"},
  {623U, PokemonType::Bug, 90U, 100U, MoveCategory::Physical, 10U, 2, 0U, "FIRST_IMPRESSION"},
  {626U, PokemonType::Dark, 85U, 100U, MoveCategory::Physical, 10U, 0, 0U, "DARKEST_LARIAT"},
  {627U, PokemonType::Water, 90U, 100U, MoveCategory::Special, 10U, 0, 0U, "SPARKLING_ARIA"},
  {650U, PokemonType::Dragon, 100U, 100U, MoveCategory::Special, 10U, 0, 0U, "CORE_ENFORCER"},
  {654U, PokemonType::Dragon, 110U, 100U, MoveCategory::Special, 5U, 0, 0U, "CLANGING_SCALES"},
  {663U, PokemonType::Rock, 40U, 100U, MoveCategory::Physical, 20U, 1, 0U, "QUICK_ATTACK"},
  {664U, PokemonType::Water, 85U, 100U, MoveCategory::Physical, 10U, 0, 20U, "DEFENSE_DOWN_HIT"},
  {666U, PokemonType::Ghost, 90U, 100U, MoveCategory::Physical, 10U, 0, 0U, "SPECTRAL_THIEF"},
